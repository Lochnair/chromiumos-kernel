/*
 * Copyright 2019 MediaTek Inc.
 * Author: Eddie Huang <eddie.huang@mediatek.com>
 *
 * This program is free software; you can redistribute it and/or modify
 * it under the terms of the GNU General Public License version 2 as
 * published by the Free Software Foundation.
 *
 * This program is distributed in the hope that it will be useful,
 * but WITHOUT ANY WARRANTY; without even the implied warranty of
 * MERCHANTABILITY or FITNESS FOR A PARTICULAR PURPOSE.  See the
 * GNU General Public License for more details.
 */

/dts-v1/;
#include "mt8173-hana.dtsi"

/ {
	model = "Mediatek Hana rev7 board";
	compatible = "google,hana-rev7", "mediatek,mt8173";
};

&cpu_thermal {
	trips {
		cpu_crit: cpu_crit@0 {
			temperature = <100000>;
			type = "critical";
		};
	};
};
