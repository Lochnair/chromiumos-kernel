## Documentation/devicetree/bindings/soc/qcom/qcom,tz_usr_iface.txt
```
QTI TZ_USER_INTERFACE

TZ user interface driver provides the support to handle the XPU violations
found by TZ, read or write the data from the user space.

Required properties:
- compatible: must contain "qti,tz-usr-iface"

Optional properties:
-qti,xpu-interrupt-support: indicates whether the driver should get the
				interrupt if any XPU violation found

Required child node properties if qti,xpu-interrupt-support property present:
- interrupts: must contain the interrupt line information to be used
- reg_val: must contain the TCSR WONCE register value

Optional properties:

- qti,panic-on-xpu-violation: indicates whether to panic the system if XPU
				violation is found by TZ

Example:
	tz_usr_iface: qti,tzuserinterface {
		compatible = "qti,tz-usr-iface";
		qti,xpu-interrupt-support;
		intr0 {
			interrupts = <0 234 0>;
			reg_val = <0x193D010>;
			qti,panic-on-xpu-violation;
		};
	};
```

## drivers/vhost/Kconfig
```kconfig
config VHOST_NET
	tristate "Host kernel accelerator for virtio net"
	depends on NET && EVENTFD && (TUN || !TUN) && (MACVTAP || !MACVTAP)
	select VHOST
	---help---
	  This kernel module can be loaded in host kernel to accelerate
	  guest networking with virtio_net. Not to be confused with virtio_net
	  module itself which needs to be loaded in guest kernel.

	  To compile this driver as a module, choose M here: the module will
	  be called vhost_net.

config VHOST_SCSI
	tristate "VHOST_SCSI TCM fabric driver"
	depends on TARGET_CORE && EVENTFD && m
	select VHOST
	default n
	---help---
	Say M here to enable the vhost_scsi TCM fabric module
	for use with virtio-scsi guests

config VHOST_VSOCK
	tristate "vhost virtio-vsock driver"
	depends on VSOCKETS && EVENTFD
	select VIRTIO_VSOCKETS_COMMON
	select VHOST
	default n
	---help---
	This kernel module can be loaded in the host kernel to provide AF_VSOCK
	sockets for communicating with guests.  The guests must have the
	virtio_transport.ko driver loaded to use the virtio-vsock device.

	To compile this driver as a module, choose M here: the module will be called
	vhost_vsock.

config VHOST_RING
	tristate
	---help---
	  This option is selected by any driver which needs to access
	  the host side of a virtio ring.

config VHOST
	tristate
	---help---
	  This option is selected by any driver which needs to access
	  the core of vhost.
```
